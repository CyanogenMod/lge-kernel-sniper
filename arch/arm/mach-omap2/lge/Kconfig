## arch/arm/mach-omap2/lge/Kconfig
```kconfig
menu "LGE Device-Specific Changes"

menu "LGE Board Selection"

config LGE_ATS_INPUT_DEVICE
	bool "Support LGE ATS input device"
	default n
	depends on MACH_LGE_OMAP3
	help
	 Choose if use ATS input device used for generating input event from user space

config LGE_DIAG_TESTMODE
	bool "Support LGE diag TESTMODE"
	default n
	depends on MACH_LGE_OMAP3 
	help
	  LGE diag TESTMODE enable

config LGE_DIAG_ICD
	bool "Support LGE diag ICD"
	default n
	depends on MACH_LGE_OMAP3
	help
	  LGE diag LCD ICD enable

config LGE_OMAP3_POWER_SAVE_DEBUG
	bool "Support Debug Message for Power Save"
	default n
	depends on MACH_LGE_OMAP3
	help
	  Debug Message for Power Save

endmenu

endmenu
```

## drivers/broadcast/Kconfig
```kconfig
#
# Broadcast Device Driver Support
#

menu "LGE Broadcast Device Support"

config LGE_BROADCAST_TDMB
	bool "LGE broacast TDMB device driver"
	depends on PRODUCT_LGE_KU5900 || PRODUCT_LGE_LU6800
	default n
	help
	  Select this if you want to use TDMB broadcast service

source "drivers/broadcast/tdmb/Kconfig"
endmenu
```

## drivers/broadcast/tdmb/Kconfig
```kconfig
#
# Broadcast Device Driver Support
#

#menu "BROADCAST_DEVICE"

config LGE_BROADCAST_FC8050
	bool "LGE broacast TDMB FC8050 device"
	depends on LGE_BROADCAST_TDMB && (PRODUCT_LGE_KU5900 || PRODUCT_LGE_LU6800)
	default y
	help
	  Select this if you want to use broadcast service

#endmenu
```

## drivers/broadcast/tdmb/fc8050/Kconfig
```kconfig
#
# FC8050_DEVICE subsystem configuration
#

#menu "FC8050 support"

config LGE_BROADCAST_FC8050
	bool "fc8050 device support"
	default n
  
#endmenu
```

## drivers/hub/Kconfig
```kconfig
# drivers/hub/Kconfig
menu "LGE Hub board drivers"

config LGE_MTC_ETA
        bool "Support LGE MTC_ETA Event (Key, Touch) Logging"
        default n
        depends on PRODUCT_LGE_KU5900 || PRODUCT_LGE_LU6800 || MACH_LGE_HUB
        help
         LGE MTC/ETA

comment "Audio"

config HUB_AMP_WM9093
	bool "AUDIO_AMP_WM9093"
	depends on PRODUCT_LGE_KU5900 || PRODUCT_LGE_LU6800 || MACH_LGE_HUB
	default y
	help
	  Support for WM9093 AUD AMP driver

config HUB_HEADSET_DET
	bool "HUB HEADSET DETECTION"
	depends on PRODUCT_LGE_KU5900 || PRODUCT_LGE_LU6800 || MACH_LGE_HUB
	default y
	help
	  Support for headset detection


comment "External Power and USB Switch"

config HUB_MUIC
	bool "Hub TI TS5USBA33402 MUIC Driver"
	depends on PRODUCT_LGE_KU5900 || PRODUCT_LGE_LU6800 || MACH_LGE_HUB && !LGE_LAB3_BOARD
	default y
	---help---
		Support for TS5USBA33402 MUIC Driver

config LGE_OMAP3_EXT_PWR
	bool "LGE External Power Sensing use TWL5030"
	depends on MACH_LGE_OMAP3 && LGE_LAB3_BOARD
	default y
	---help---
		Support for external power sensing without MUIC

config LGE_USB_SWITCH
	bool "LGE USB Swtich Driver ( EUSY038501 and NTJD4105CT1G)"
	depends on MACH_LGE_OMAP3 && LGE_LAB3_BOARD
	default y
	---help---
		Support for High Speed USB Switch Driver ( EUSY038501 and NTJD4105CT1G)

config LGE_CHARGE_CONTROL_BATTERY_FET
	bool "Chrging Control Using Battery FET"
	depends on MACH_LGE_OMAP3 && LGE_LAB3_BOARD
	default n
	---help---
		charging Control by battery fet, not Charger IC


config HUB_CHARGING_IC
	bool "Hub Charging IC Driver"
	depends on PRODUCT_LGE_KU5900 || PRODUCT_LGE_LU6800 || MACH_LGE_HUB
	default y
	---help---
		Support for CHARGING IC Driver

config KERNEL_GSM0710MUX
	bool "Kernel mode gsm0710 multiplexer"
	depends on PRODUCT_LGE_KU5900 || PRODUCT_LGE_LU6800 || MACH_LGE_HUB
	default y
	---help---
	  Kernel mode gsm0710 multiplexor over the spi driver

config RINETWORK_DRIVER
	bool "Raw ip network driver"
	depends on PRODUCT_LGE_KU5900 || PRODUCT_LGE_LU6800 || MACH_LGE_HUB
	default y
	---help---
	  Support for raw ip network driver

config HUB_MODEM_CONTROL
	bool "MODEM - Hub Modem control"
	depends on PRODUCT_LGE_KU5900 || PRODUCT_LGE_LU6800 || MACH_LGE_HUB
	default y
        ---help---
            Modem control driver

config HUB_GPS_GPIO
	bool "Broadcom GPS GPIO Controller"
	depends on PRODUCT_LGE_KU5900 || PRODUCT_LGE_LU6800 || MACH_LGE_HUB
	default y
	---help---
		Broadcom GPS GPIO control driver

config BD_ADDRESS
	bool "BD Read / Write Driver"
	default y
	help
	  LGE added: It supports Bluetooth address Read / Write functionality on user mode.

endmenu
```

## drivers/media/video/omap/Kconfig
```kconfig
config VIDEO_OMAP2_VOUT
	tristate "OMAP2/OMAP3 V4L2-Display driver"
	depends on ARCH_OMAP2 || ARCH_OMAP3
	select VIDEOBUF_GEN
	select VIDEOBUF_DMA_CONTIG
	select OMAP2_DSS
	select OMAP2_VRAM
	select OMAP2_VRFB
	default n
	---help---
	  V4L2 Display driver support for OMAP2/3 based boards.

#from GB
config OMAP2_VRFB
	bool
	depends on ARCH_OMAP2 || ARCH_OMAP3
	default y if VIDEO_OMAP2_VOUT
	help
	  VRFB used in V4L2 in OMAP2,3

config OMAP3_ISP_RESIZER
	bool
	depends on ARCH_OMAP3
	default y if VIDEO_OMAP2_VOUT
	help
	  ISP resizer used in V4L2 in OMAP3
```

## drivers/misc/bj_sensors/Kconfig
```kconfig
# drivers/bj_sensors
menu "LGE Justin/Black Sensor Drivers"

comment "Sensors"

config BJ_SENSORS
	bool "Black & Justin Sensors"
	default y
	help
	  Support for LGE Optimus Black & Justin Sensors
	
config BJ_PROXI_SENSOR 
	bool "LGE Black & Justin Proximity Sensor Driver"
	depends on BJ_SENSORS
	default y
	help
	  Support for Proxi-sensor
	  
config BJ_KXTF9_SENSOR
	bool "LGE Black & Justin Accelerometer Sensor Driver"
	depends on BJ_SENSORS
	default y
	help
	  Support for Accelerometer Sensor

config BJ_COMPASS_SENSOR
        bool "LGE Black & Justin Compass Sensor Driver"
        depends on BJ_SENSORS
        default y
        help
          This enables the Compass Sensor akm8973 Driver for the HUB.

config BJ_MPU3050_SENSOR
        bool "LGE Black & Justin Gyro Sensor Driver"
        depends on BJ_SENSORS
        default y
        help
          This enables the Gyro Sensor mpu3050 Driver for the HUB.

config BJ_MOTION_SENSOR
	bool "LGE Black & Justin Motion Sensor Driver"
        depends on BJ_SENSORS
        default y        
        help
	  Support for Motion Sensor
		
endmenu
```

## drivers/misc/mpu3050/Kconfig
```kconfig
config MPU_SENSORS_MPU3050
    tristate "MPU3050"
    default y
    help
      If you say yes here you get support for the MPU3050 Gyroscope driver
      This driver can also be built as a module.  If so, the module
      will be called mpu3050.

config MPU_SENSORS_KXTF9
    bool "Kionix KXTF9"
    default y
    help
      This enables support for the Kionix KXFT9 accelerometer

config MPU_SENSORS_AK8975
    bool "AKM akm8975"
    default y
    help
      This enables support for the AKM ak8975 compass

#config MPU_SENSORS_TIMERIRQ
#    bool "Timer IRQ"
#    default y
#    help
#      If you say yes here you get access to the timerirq device handle which
#      can be used to select on.  This can be used instead of IRQ's, sleeping,
#      or timer threads.  Reading from this device returns the same type of
#      information as reading from the MPU and slave IRQ's.

#config MPU_SENSORS_DEBUG
#    bool "MPU debug"
#    default y
#    help
#      If you say yes here you get extra debug messages from the MPU3050
#      and other slave sensors.
```

## drivers/muic/Kconfig
```kconfig
menuconfig MUIC
	tristate "MUIC class support"
	help
	  Say Y here to enable MUIC class support. This allows
	  controlling & monitoring muic related devices.

if MUIC

# from P940 ICS
config MUIC_MAX14526DEEWP
	tristate "MUIC max14526 driver"
	help
	  Say Y here to support max14526 muic device.

config MUIC_TS5USBA33402 
	tristate "MUIC ts5usba33402 driver"
	help
	  Say Y here to support ts5usba33402 muic device.

config MUIC_TSU5611
	tristate "MUIC tsu5611 driver"
	help
	  Say Y here to support tsu5611 muic device.

config MUIC_TSU5611_INIT_BUG_FIX
	bool "TSU5611 init bug fix"
	help
	  When boot up timing, CHG_TYPE must be set within TSU5611.
	  This is chip bug of TSU5611.

	  Say Y here to fix tsu5611 init bug.

choice
	prompt "revision"
	depends on MUIC_TS5USBA33402
	
config MUIC_TS5USBA33402_REV_A
	bool "MUIC ts5usba33402 revision A"
	depends on MUIC_TS5USBA33402
	help
	  Say Y here to support ts5usba33402 muic device rev A.

config MUIC_TS5USBA33402_REV_B
	bool "MUIC ts5usba33402 revision B"
	depends on MUIC_TS5USBA33402
	help
		Say Y here to support ts5usba33402 muic device rev B.
endchoice

config DP3T 
	tristate "DP3T switch driver"
	help
	  Say Y here to support dp3t switch muic client device.

config USIF 
	tristate "USIF driver"
	help
	  Say Y here to support usif swtich muic cleint device.

endif # MUIC
```

## drivers/video/hdmi/Kconfig
```kconfig
config NXP_HDMI
        tristate "NXP HDMI support (EXPERIMENTAL)"
        help
          NXP HDMI Driver.

config OMAP3_HDMI
	tristate "OMAP3 HDMI for HUB_PROJECT."
	default n
	help
	  OMAP3 HDMI for HUB_PROJECT.
```
